// ErrP robot arm: one cup game guided by real brain "oops" signals
// Generated by step4_make_wokwi.py (person 6, game 1).
// Base servo: pin 9. Gripper servo: pin 10. Green LED (ok): pin 11. Red LED (oops): pin 12.
#include <Servo.h>

const int N_STEPS = 30;
const byte KIND[N_STEPS] = {0, 0, 0, 0, 0, 0, 0, 1, 0, 0, 0, 0, 0, 1, 0, 0, 0, 0, 0, 0, 0, 0, 0, 0, 0, 0, 0, 0, 0, 1};  // 0 = move to a cup, 1 = reach + final brain check
const byte CUP[N_STEPS]  = {1, 0, 1, 0, 1, 2, 1, 1, 0, 1, 0, 1, 2, 1, 1, 2, 3, 2, 1, 2, 1, 2, 3, 2, 1, 2, 3, 2, 3, 2};   // cup 0..4 (shown as 1..5)
const byte OOPS[N_STEPS] = {0, 1, 0, 1, 0, 1, 0, 1, 1, 1, 1, 0, 1, 1, 1, 0, 1, 1, 1, 0, 1, 1, 1, 1, 1, 0, 1, 0, 1, 0};  // what the detector said: 1 = oops, 0 = ok
const byte WANTED = 2;          // the cup the person wanted (the arm does not know this)
const byte START_CUP = 2;
const byte CHOICE = 2;         // the cup the arm finally grabs

const int GREEN = 11, RED = 12;
Servo base, grip;
int angle;

int angleFor(byte cup) { return 160 - 35 * cup; }  // cup 1 on the left ... cup 5 on the right

void turnTo(int target) {
  while (angle != target) {
    angle += (target > angle) ? 1 : -1;
    base.write(angle);
    delay(12);
  }
}

void showBrain(byte oops) {
  digitalWrite(oops ? RED : GREEN, HIGH);
  Serial.println(oops ? "   brain: OOPS!" : "   brain: ok");
  delay(900);
  digitalWrite(RED, LOW);
  digitalWrite(GREEN, LOW);
}

void setup() {
  Serial.begin(9600);
  pinMode(GREEN, OUTPUT);
  pinMode(RED, OUTPUT);
  base.attach(9);
  grip.attach(10);
  grip.write(0);  // gripper open
  angle = angleFor(START_CUP);
  base.write(angle);
  Serial.println("ErrP robot arm: which cup does the person want?");
  Serial.println("(the arm does not know - it only reads the brain's oops signals)");
  delay(1500);

  for (int i = 0; i < N_STEPS; i++) {
    Serial.print("Move ");
    Serial.print(i + 1);
    if (KIND[i] == 0) Serial.print(": arm turns to cup ");
    else Serial.print(": 90% sure - reaching for cup ");
    Serial.println(CUP[i] + 1);
    turnTo(angleFor(CUP[i]));
    delay(300);
    showBrain(OOPS[i]);
    if (KIND[i] == 1 && OOPS[i]) Serial.println("   final check said oops - not grabbing, keep looking");
  }

  Serial.print("Grabbing cup ");
  Serial.println(CHOICE + 1);
  turnTo(angleFor(CHOICE));
  for (int a = 0; a <= 90; a++) { grip.write(a); delay(10); }
  Serial.print("The person wanted cup ");
  Serial.print(WANTED + 1);
  Serial.println(CHOICE == WANTED ? " - CORRECT!" : " - wrong cup");
}

void loop() {}
